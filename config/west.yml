## config/west.yml
```yaml
manifest:
  remotes:
    - name: zmkfirmware
      url-base: https://github.com/zmkfirmware
    - name: gpeye
      url-base: https://github.com/GPeye
    - name: englmaxi
      url-base: https://github.com/englmaxi
    - name: M165437
      url-base: https://github.com/M165437
    - name: mctechnology17
      url-base: https://github.com/mctechnology17
    - name: carlosedp
      url-base: https://github.com/carlosedp
    # - name: zmk-nice-oled-alt
    #   url-base: https://gitlab.com/open-source-open-colab
  projects:
    - name: zmk
      remote: zmkfirmware
      revision: main
      path: zmk
      import: app/west.yml
    - name: zmk-dongle-display
      remote: englmaxi
      revision: main
      path: deps/zmk-dongle-display
    - name: nice-view-gem
      remote: M165437
      revision: main
      path: deps/nice-view-gem
    - name: zmk-nice-oled
      remote: mctechnology17 # switched to alternative remote for zmk-nice-oled until it suppports ZMK 4.1
      # remote: zmk-nice-oled-alt
      revision: main
      path: deps/zmk-nice-oled
    - name: hammerbeam-slideshow
      remote: gpeye
      revision: main
      path: deps/hammerbeam-slideshow
    - name: zmk-switch-layout
      remote: mctechnology17
      revision: main
      path: deps/zmk-switch-layout
    # Fork of https://github.com/lever-tech/flake-firmware (Lever Flake shield), pinned to a commit.
    # Bump the SHA after syncing the fork and reviewing the changes (see `./build_local.sh update`).
    - name: flake-firmware
      remote: carlosedp
      revision: 004650b51da5a943030962b89b37f8896064d013
      path: deps/flake-firmware
  self:
    path: config
```
